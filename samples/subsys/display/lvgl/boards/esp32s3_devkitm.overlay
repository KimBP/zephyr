
/ {

	arduino_header: connector {
		compatible = "arduino-header-r3";
		#gpio-cells = <2>;
		gpio-map-mask = <0xffffffff 0xffffff00>;
		gpio-map-pass-thru = <0x0 0xff>;
		gpio-map = 
				<0 0 &gpio0 7 0>,	/* A0 *//* RD */
				<1 0 &gpio0 6 0>,	/* A1 *//* WR */
				<2 0 &gpio0 5 0>,	/* A2 *//* C/D */
				<3 0 &gpio0 4 0>,	/* A3 *//* CS */
				<4 0 &gpio0 3 0>,	/* A4 */
				<5 0 &gpio0 2 0>,	/* A5 */
				<6 0 &gpio0 1 0>,	/* D0 */
				<7 0 &gpio0 0 0>,	/* D1 */
				<8 0 &gpio1 14 0>,	/* D2 */
				<9 0 &gpio1 13 0>,	/* D3 */
				<10 0 &gpio0 8 0>,	/* D4 *//* LCD 4 */
				<11 0 &gpio1 12 0>,	/* D5 */
				<12 0 &gpio0 10 0>,	/* D6 *//* LCD 6 */
				<13 0 &gpio0 11 0>,	/* D7 *//* LCD 7 */
				<14 0 &gpio0 12 0>,	/* D8 *//* LCD 0 */
				<15 0 &gpio0 13 0>,	/* D9 *//* LCD 1 */
				<16 0 &gpio0 14 0>,	/* D10 *//* LCD 2 */
				<17 0 &gpio0 15 0>,	/* D11 *//* LCD 3 */
				<18 0 &gpio1 11 0>,	/* D12 */
				<19 0 &gpio0 16 0>,	/* D13 *//* LCD 5 */
				<20 0 &gpio0 17 0>,	/* D14 */
				<21 0 &gpio0 18 0>;	/* D15 */
	};
};



