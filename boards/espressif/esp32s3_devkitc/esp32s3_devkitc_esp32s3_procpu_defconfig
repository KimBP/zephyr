## boards/espressif/esp32s3_devkitc/esp32s3_devkitc_esp32s3_procpu_defconfig
```kconfig
# SPDX-License-Identifier: Apache-2.0

CONFIG_MAIN_STACK_SIZE=2048

CONFIG_CONSOLE=y
CONFIG_SERIAL=y
CONFIG_UART_CONSOLE=y
CONFIG_GPIO=y
CONFIG_CLOCK_CONTROL=y

# Model n8r8
CONFIG_SPIRAM_MODE_OCT=y
CONFIG_ESP_SPIRAM_SIZE=8388608
```

## boards/xtensa/esp32s3_devkitc/Kconfig.board
```kconfig
# Copyright (c) 2024 Kim Bøndergaard <kim@fam-boendergaard.dk>
# SPDX-License-Identifier: Apache-2.0

# ESP32S3 DevKitC board configuration
config BOARD_ESP32S3_DEVKITC
	bool "ESP32S3 DevKitC Board"
	depends on SOC_SERIES_ESP32S3

config BOARD_ESP32S3_DEVKITC_APPCPU
	bool "ESP32S3 Board configuration for APPCPU (core 1)."
	depends on SOC_SERIES_ESP32S3 && SOC_ESP32S3_APPCPU

choice SOC_PART_NUMBER
	default SOC_ESP32S3_WROOM_N8R8
endchoice
```

## boards/xtensa/esp32s3_devkitc/Kconfig.defconfig
```kconfig
# ESP32S3 DevKitC board configuration

# Copyright (c) 2024 Kim Bøndergaard <kim@fam-boendergaard.dk>
# SPDX-License-Identifier: Apache-2.0

if BOARD_ESP32S3_DEVKITC

config BOARD
	default "esp32s3_devkitc"

config HEAP_MEM_POOL_ADD_SIZE_BOARD
	int
	default 65535 if WIFI && BT
	default 51200 if WIFI
	default 40960 if BT
	default 4096

choice BT_HCI_BUS_TYPE
	default BT_ESP32 if BT
endchoice

endif

if BOARD_ESP32S3_DEVKITC_APPCPU

config BOARD
	default "esp32s3_devkitc_appcpu"

config HEAP_MEM_POOL_ADD_SIZE_BOARD
	def_int 4096

config KERNEL_BIN_NAME
	default "esp32_appcpu_firmware"
endif

config ENTROPY_GENERATOR
	default y
```

## drivers/display/Kconfig.esp32_lcd_cam_rgb
```kconfig
# Copyright (c) 2026 Kim Bøndergaard <kim@fam-boendergaard.dk>
# SPDX-License-Identifier: Apache-2.0

config DISPLAY_ESP32_LCD_CAM_RGB
	bool "ESP32 LCD_CAM RGB scanout backend"
	default y
	select DISPLAY_RGB_SCANOUT
	depends on SOC_SERIES_ESP32S3
	depends on DT_HAS_ESPRESSIF_ESP32_LCD_CAM_RGB_ENABLED
	help
	  Enable RGB scanout backend for ESP32-S3 LCD_CAM.
	  This backend is used by RGB panel drivers through the generic
	  display RGB scanout interface.

config DISPLAY_ESP32_LCD_CAM_RGB_BOUNCE_BUFFER_SIZE
	int "LCD_CAM RGB bounce buffer size per instance (bytes)"
	depends on DISPLAY_ESP32_LCD_CAM_RGB
	range 1024 65536
	default 16128
	help
	  Maximum internal SRAM reserved for the bounce buffers of each
	  LCD_CAM RGB scanout instance. The driver selects a layout within this
	  limit based on the framebuffer size. Each DMA chunk must be 256 to
	  4032 bytes and a multiple of 64 bytes. The DMA ring contains at least
	  four bounce buffers, each holding one chunk. The framebuffer must divide
	  evenly into chunks, with a whole number of frame chunks per ring cycle.
```

## drivers/display/Kconfig.st7701_rgb
```kconfig
# Copyright (c) 2026 Kim Bøndergaard
# SPDX-License-Identifier: Apache-2.0

config ST7701_RGB
	bool "Waveshare ST7701 RGB panel (skeleton)"
	default y
	depends on DISPLAY
	depends on DT_HAS_SITRONIX_ST7701_RGB_ENABLED
	select MIPI_DBI
	help
	  Enable skeleton driver for ST7701 in RGB panel use-cases where
	  initialization commands are sent over a MIPI-DBI command channel.

config ST7701_RGB_INIT_PRIORITY
	int "ST7701 RGB init priority"
	default 85
	depends on ST7701_RGB
	help
	  Initialization priority for the ST7701 RGB panel skeleton driver.
```

## dts/bindings/display/espressif,esp32-lcd-cam-rgb.yaml
```yaml
# Copyright (c) 2026 Kim Bondergaard
# SPDX-License-Identifier: Apache-2.0

description: ESP32 LCD_CAM RGB scanout host configuration

compatible: "espressif,esp32-lcd-cam-rgb"

include: base.yaml

properties:
  width:
    type: int
    required: true
    description: Active horizontal resolution in pixels.

  height:
    type: int
    required: true
    description: Active vertical resolution in lines.

  data-bus-width:
    type: int
    required: true
    enum: [16, 18, 24]
    description: Parallel RGB data bus width.

  clock-frequency:
    type: int
    required: true
    description: Pixel clock for RGB scanout in Hz.

  hsync-len:
    type: int
    required: true
    description: Horizontal sync pulse width in pixel clocks.

  hback-porch:
    type: int
    required: true
    description: Horizontal back porch in pixel clocks.

  hfront-porch:
    type: int
    required: true
    description: Horizontal front porch in pixel clocks.

  vsync-len:
    type: int
    required: true
    description: Vertical sync pulse width in lines.

  vback-porch:
    type: int
    required: true
    description: Vertical back porch in lines.

  vfront-porch:
    type: int
    required: true
    description: Vertical front porch in lines.

  hsync-active:
    type: int
    required: true
    enum: [0, 1]
    description: Horizontal sync polarity; 0 low-active, 1 high-active.

  vsync-active:
    type: int
    required: true
    enum: [0, 1]
    description: Vertical sync polarity; 0 low-active, 1 high-active.

  de-active:
    type: int
    required: true
    enum: [0, 1]
    description: Data-enable polarity; 0 low-active, 1 high-active.

  pixelclk-active:
    type: int
    required: true
    enum: [0, 1]
    description: Pixel clock polarity; 0 drive data on falling edge, 1 on rising edge.
```

## dts/bindings/display/sitronix,st7701-rgb.yaml
```yaml
# Copyright (c) 2026 Kim Bøndergaard <kim@fam-boendergaard.dk>
# SPDX-License-Identifier: Apache-2.0

title: Sitronix ST7701 RGB panel with DBI command channel

description: |
  ST7701 panel used in RGB scanout mode where panel control commands are sent
  over a MIPI-DBI SPI command channel.
  RGB scanout timing is configured on the RGB host controller node

compatible: "sitronix,st7701-rgb"

include: [mipi-dbi-spi-device.yaml, display-controller.yaml]

properties:
  scanout:
    type: phandle
    required: true
    description: Phandle to the RGB scanout backend device used for framebuffer transfer.

  pvgamctrl:
    type: uint8-array
    required: true
    description: Positive voltage gamma control payload, including command byte (0xB0).

  nvgamctrl:
    type: uint8-array
    required: true
    description: Negative voltage gamma control payload, including command byte (0xB1).

  gip-e0:
    type: uint8-array
    required: true
    description: GIP setting at address 0xE0, including command byte.

  gip-e1:
    type: uint8-array
    required: true
    description: GIP setting at address 0xE1, including command byte.

  gip-e2:
    type: uint8-array
    required: true
    description: GIP setting at address 0xE2, including command byte.

  gip-e3:
    type: uint8-array
    required: true
    description: GIP setting at address 0xE3, including command byte.

  gip-e4:
    type: uint8-array
    required: true
    description: GIP setting at address 0xE4, including command byte.

  gip-e5:
    type: uint8-array
    required: true
    description: GIP setting at address 0xE5, including command byte.

  gip-e6:
    type: uint8-array
    required: true
    description: GIP setting at address 0xE6, including command byte.

  gip-e7:
    type: uint8-array
    required: true
    description: GIP setting at address 0xE7, including command byte.

  gip-e8:
    type: uint8-array
    required: true
    description: GIP setting at address 0xE8, including command byte.

  gip-eb:
    type: uint8-array
    required: true
    description: GIP setting at address 0xEB, including command byte.

  gip-ec:
    type: uint8-array
    required: true
    description: GIP setting at address 0xEC, including command byte.

  gip-ed:
    type: uint8-array
    required: true
    description: GIP setting at address 0xED, including command byte.

  reset-gpios:
    type: phandle-array
    description: GPIO controlling ST7701 reset line.

  reset-delay-ms:
    type: int
    required: true
    description: Delay in milliseconds while reset is asserted.

  inversion-on:
    type: boolean
    description: Enable display inversion mode during initialization.
```

## modules/NMEA2000/Kconfig
```kconfig
# Copyright (c) 2025 Kim Bøndergaard <kim@fam-boendergaard.dk>
# SPDX-License-Identifier: Apache-2.0

config ZEPHYR_NMEA2000_MODULE
        bool

config NMEA2000
        bool "Support for NMEA2000 from timo.lappalainen@kave.fi"
	depends on CPP
	depends on CAN
        help
          This option enables the NMEA2000 library
```

## modules/lvglcpp/Kconfig
```kconfig
# Copyright (c) 2024 Kim Bøndergaard <kim@fam-boendergaard.dk>
# SPDX-License-Identifier: Apache-2.0

config ZEPHYR_LVGLCPP_MODULE
        bool

config LVGLCPP
        bool "LVGL CPP Support - based on lv"
	select LVGL
        help
          This option enables the LVGL Plus Plus library
```

## modules/lvglpp/Kconfig
```kconfig
# Copyright (c) 2024 Kim Bøndergaard <kim@fam-boendergaard.dk>
# SPDX-License-Identifier: Apache-2.0

config ZEPHYR_LVGLPP_MODULE
        bool

config LVGLPP
        bool "LVGL CPP Support - based on lvglpp"
	select LVGL
        help
          This option enables the LVGL Plus Plus library
```

## soc/espressif/Kconfig
```kconfig
# Copyright (c) 2023 Espressif Systems (Shanghai) Co., Ltd.
# SPDX-License-Identifier: Apache-2.0

if SOC_FAMILY_ESPRESSIF_ESP32

rsource "*/Kconfig"
source "common/Kconfig.esptool"
source "common/Kconfig.spiram"

endif # SOC_FAMILY_ESPRESSIF_ESP32
```
