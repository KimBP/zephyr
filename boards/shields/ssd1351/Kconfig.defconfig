## boards/shields/ssd1351/Kconfig.defconfig
```kconfig
# Copyright (c) 2019 Linaro Limited
# SPDX-License-Identifier: Apache-2.0

if SHIELD_SSD1351_128X128

if DISPLAY


config SPI
	default y


config SSD1351
	default y


if LVGL

config LVGL_DISPLAY_DEV_NAME
	default "SSD1351"

config LVGL_HOR_RES_MAX
	default 128

config LVGL_VER_RES_MAX
	default 128

config LVGL_VDB_SIZE
	default 64

config LVGL_DPI
	default 148

config LVGL_BITS_PER_PIXEL
	default 16

choice LVGL_COLOR_DEPTH
	default LVGL_COLOR_DEPTH_16
endchoice

endif # LVGL

endif # DISPLAY

endif # SHIELD_SSD1351_128X128
```

## boards/shields/ssd1351/Kconfig.shield
```kconfig
# Copyright (c) 2019 Linaro Limited
# SPDX-License-Identifier: Apache-2.0

config SHIELD_SSD1351_128X128
	def_bool $(shields_list_contains,ssd1351_128x128)
```

## drivers/display/Kconfig.ssd1351
```kconfig
# SSD1306 display controller configuration options

# Copyright (c) 2018 Phytec Messtechnik GmbH
# SPDX-License-Identifier: Apache-2.0

menuconfig SSD1351
	bool "SSD1351"
	depends on SPI
	help
	  Enable driver for SSD1306 display driver.

if SSD1351

config SSD1351_DEFAULT_CONTRAST
	int "SSD1351 default contrast"
	default 128
	range 0 255
	help
	  SSD1351 default contrast.

choice SSD1351_CONTROLLER_TYPE
	prompt "Display controller type"
	default SSD1351_DEFAULT
	help
	  Specify the type of the controller.

config SSD1351_DEFAULT
	bool "Default SSD1351 controller"

endchoice

config SSD1351_REVERSE_MODE
	bool "SSD1351 reverse mode"
	help
	  SSD1351 reverse video mode.

endif # SSD1351
```
